## boards/arm/EviSense-pcb-v-2-3/Kconfig.board
```kconfig
# Thingy:91 nRF9160 board configuration
#
# Copyright (c) 2019 Nordic Semiconductor ASA
#
# SPDX-License-Identifier: LicenseRef-BSD-5-Clause-Nordic

if SOC_NRF9160_SICA

config BOARD_EVISENSE_V_2_3
	bool "EviSense v2.3"

config BOARD_EVISENSE_V_2_3_NS
	bool "EviSense v2.3 non-secure"

endif # SOC_NRF9160_SICA
```

## boards/arm/EviSense-pcb-v-2-3/Kconfig.defconfig
```kconfig
# Thingy:91 nRF9160 board configuration
#
# Copyright (c) 2018 Nordic Semiconductor ASA
#
# SPDX-License-Identifier: LicenseRef-Nordic-5-Clause

if BOARD_EVISENSE_V_2_3 || BOARD_EVISENSE_V_2_3_NS

config BOARD
	default "EviSense board v2.3"

# By default, if we build for a Non-Secure version of the board,
# enable building with TF-M as the Secure Execution Environment.
config BUILD_WITH_TFM
	default y if BOARD_EVISENSE_V_2_3_NS

if BUILD_WITH_TFM

# By default, if we build with TF-M, instruct build system to
# flash the combined TF-M (Secure) & Zephyr (Non Secure) image
config TFM_FLASH_MERGED_BINARY
	bool
	default y

endif # BUILD_WITH_TFM

# For the secure version of the board the firmware is linked at the beginning
# of the flash, or into the code-partition defined in DT if it is intended to
# be loaded by MCUboot. If the secure firmware is to be combined with a non-
# secure image (TRUSTED_EXECUTION_SECURE=y), the secure FW image shall always
# be restricted to the size of its code partition.
# For the non-secure version of the board, the firmware
# must be linked into the code-partition (non-secure) defined in DT, regardless.
# Apply this configuration below by setting the Kconfig symbols used by
# the linker according to the information extracted from DT partitions.

if BOARD_EVISENSE_V_2_3 && TRUSTED_EXECUTION_SECURE

config FLASH_LOAD_SIZE
	default $(dt_chosen_reg_size_hex,$(DT_CHOSEN_Z_CODE_PARTITION))

endif # BOARD_THINGY91_NRF9160 && TRUSTED_EXECUTION_SECURE

if BOARD_EVISENSE_V_2_3_NS

config FLASH_LOAD_OFFSET
	default $(dt_chosen_reg_addr_hex,$(DT_CHOSEN_Z_CODE_PARTITION))

config FLASH_LOAD_SIZE
	default $(dt_chosen_reg_size_hex,$(DT_CHOSEN_Z_CODE_PARTITION))

endif # BOARD_EVISENSE_V_2_3_NS

config BT_HCI_VS
	default y if BT

config HW_STACK_PROTECTION
	default ARCH_HAS_STACK_PROTECTION

endif # BOARD_EVISENSE_V_2_3 || BOARD_EVISENSE_V_2_3_NS
```
